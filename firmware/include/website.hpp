#pragma once
/**
 * This file is part of HackTheBom.
 * HackTheBom is free software: you can redistribute it and/or modify it under the
 * terms of the GNU General Public License as published by the Free Software 
 * Foundation, either version 3 of the License, or (at your option) any later 
 * version.
 * 
 * HackTheBom is distributed in the hope that it will be useful, but WITHOUT ANY 
 * WARRANTY; without even the implied warranty of MERCHANTABILITY or FITNESS 
 * FOR A PARTICULAR PURPOSE. See the GNU General Public License for more details.
 * You should have received a copy of the GNU General Public License along with
 * HackTheBom. If not, see <https://www.gnu.org/licenses/>.
 * 
 * @file       : include/website.cpp
 * @author     : Maurice Snoeren (MS)
 * @description: 
 * @date       : 16-06-2024
 * @version    : 1.0
 * @updates    : 20-02-2024 (MS): Initial code.
 * @todo       : 
 */

#include <Arduino.h>

extern const char index_html[] PROGMEM = R"rawliteral(
<!DOCTYPE html>
<html>
    <head>
        <meta name="viewport" content="width=device-width, initial-scale=1">
        <title>HTB</title>
    </head>
    <body>
        <center>
            <div style="width:300px; border 1px solid #000;">
                <H1>Do it yourself bom!</H1>
                <img src="data:image/png;base64, iVBORw0KGgoAAAANSUhEUgAAASsAAACaCAYAAADxRW7QAAAAAXNSR0IArs4c6QAAAARnQU1BAACx
                jwv8YQUAAAAJcEhZcwAAEnQAABJ0Ad5mH3gAAP+lSURBVHhe7L0HYFVluv0993/nzlgp6af3k+Tk
                tPSEUBVUFMUOSO+CIFZABLuodGmCDQs2VASl9xZKegFC6C1AAiQhvbK+9ewQRSczZuY63uv92GFx
                ztn13Xs/7+9dz65/wrXuWnetu9b9L+wulZb9TNdgda271l3r/ld212B1rbvWXev+EN01WF3rrnXX
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                x2WW/9D6cPvn38H9+yes/s5/4TA50MIzeJuhCsJQZgpQeIHb31/4fv63/B3sY1V+5trJwq9p+PU5
                kP3+NWn/+ffX/f1HWLXh/wf4Cf8QggjKFQAAAABJRU5ErkJggg==" alt="Red dot" />
            <h2>Introduction</h2>
            You have purchased your own do it your self bomb. Welcome to the web page which 
            hosted by your own bomb. Yes, it is an IoT bomb! You have followed the manual and now ready to configuere 
            and setup your bom. Time for action.

            <h2>Be careful</h2>
            Pay attention. Do handle the bomb with care. Any movement can lead to a possible explosion.
            Make sure you are in a calm and non-static environment.
            Remember, it's essential to remain calm. Panic only leads to sweaty hands, and that helps no one!

            <h2>Dismantling</h2>
            What? You should go for your target. Dismantling is a very dangerous action if you want to do it.
            It is possible that you need to dismantle the bomb. It is possible, but very difficult. So, just 
            go for it, but do not wait too long.

            <p><footer>Copyright 2017 (c) htb.jmnl.nl</footer></p>
        </div>

    </center>
</body>
</html>
)rawliteral";

extern const char admin_html[] PROGMEM = R"rawliteral(
<!DOCTYPE html>
<html lang="en">
<head>
    <meta charset="UTF-8">
    <meta name="viewport" content="width=device-width, initial-scale=1.0">
    <title>HTB - Admin</title>
    <style>
        table {
            width: 100%;
            border-collapse: collapse;
        }
        th, td {
            border: 1px solid black;
            padding: 8px;
            text-align: left;
        }
        th {
            background-color: #f2f2f2;
        }
        .warning-box {
            background-color: red;
            color: white;
            padding: 20px;
            text-align: center;
            font-size: 20px;
            font-weight: bold;
            border: 2px solid darkred;
            width: 500px;
            margin: 0 auto;
            border-radius: 10px;
        }
    </style>
</head>
<body>

<h1>Admin page</h1>

<div class="warning-box">
    The bomb is live! Settings cannot be changed! Disable this admin page before using the bomb in a live situation.
</div>
<br>

<table>
    <thead>
        <tr>
            <th>Parameter</th>
            <th>Description</th>
            <th>Options/Range</th>
            <th>Default</th>
        </tr>
    </thead>
    <tbody>
        <tr>
            <td>Countdown Timer</td>
            <td>Sets the countdown duration before the simulated detonation.</td>
            <td>1 to 90 minutes</td>
            <td>30 minutes</td>
        </tr>
        <tr>
            <td>Beep Frequency</td>
            <td>Determines the interval at which the device emits a beeping sound.</td>
            <td>1 second to 30 seconds</td>
            <td>1 seconds</td>
        </tr>
        <tr>
            <td>LED Light Pattern</td>
            <td>Configures the flashing pattern of the LED indicators.</td>
            <td>Steady, Blinking, Pulsing, Random</td>
            <td>Blinking</td>
        </tr>
        <tr>
            <td>Wire Colors</td>
            <td>Sets the color scheme for the device's wires for easy identification.</td>
            <td>Red, Blue, Green; Yellow, Purple, Orange; Black, White, Gray</td>
            <td>Red, Blue, Green</td>
        </tr>
        <tr>
            <td>Activation Code</td>
            <td>Specifies the code required to arm the device.</td>
            <td>4-digit number</td>
            <td>1234</td>
        </tr>
        <tr>
            <td>Deactivation Code</td>
            <td>Specifies the code required to disarm the device. It determines the order of the wires to pull or cut. Make sure it is password protected before using the bomb.</td>
            <td>4-digit hex number</td>
            <td><a href="/code">show secret code</a></td>
        </tr>
        <tr>
            <td>Sound Effects</td>
            <td>Chooses the sound effect played by the device.</td>
            <td>Beep, Buzz, Click, Custom sound (upload required)</td>
            <td>Beep</td>
        </tr>
        <tr>
            <td>Simulated Explosive Force</td>
            <td>Displays the simulated explosive force level.</td>
            <td>Low, Medium, High, Maximum</td>
            <td>Medium</td>
        </tr>
        <tr>
            <td>Error Messages</td>
            <td>Customizes the error messages displayed during malfunction.</td>
            <td>"Incorrect wire!", "Try again.", "Error detected."</td>
            <td>"Incorrect wire!"</td>
        </tr>
        <tr>
            <td>Display Brightness</td>
            <td>Adjusts the brightness of the display screen.</td>
            <td>1 (dim) to 10 (bright)</td>
            <td>5</td>
        </tr>
        <tr>
            <td>Temperature Sensor Sensitivity</td>
            <td>Simulates the sensitivity of the device to temperature changes.</td>
            <td>1 (low sensitivity) to 10 (high sensitivity)</td>
            <td>5</td>
        </tr>
        <tr>
            <td>Voice Activation</td>
            <td>Enables or disables voice command functionality for arming or disarming.</td>
            <td>On, Off</td>
            <td>Off</td>
        </tr>
        <tr>
            <td>Simulated GPS Location</td>
            <td>Sets a simulated GPS location for the device.</td>
            <td>Latitude and Longitude coordinates</td>
            <td>0.0000, 0.0000</td>
        </tr>
        <tr>
            <td>Random Event Generator</td>
            <td>Adds random events during the countdown.</td>
            <td>"Wire switch challenge", "Countdown speed doubled", "Bonus time added"</td>
            <td>Off</td>
        </tr>
    </tbody>
</table>
</body>
</html>
)rawliteral";

extern const char code_html[] PROGMEM = R"rawliteral(
<!DOCTYPE html>
<html>
    <head>
        <meta name="viewport" content="width=device-width, initial-scale=1">
        <title>HTB</title>
    </head>
    <body>
      <center>
        <p>The unique wire deactivation code for %s:</p>
        <p>%.4s</p>
      </center>
    </body>
</html>
)rawliteral";
